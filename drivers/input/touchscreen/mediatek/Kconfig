## drivers/input/touchscreen/mediatek/Kconfig
```kconfig
#
# Touchscreen driver configuration
#
menuconfig INPUT_TOUCHSCREEN
	bool "Touchscreens"
	help
	  Say Y here, and a list of supported touchscreens will be displayed.
	  This option doesn't affect the kernel.

	  If unsure, say Y.

if INPUT_TOUCHSCREEN

config TOUCHSCREEN_MTK
	bool "MediaTek Touch Panel Driver"
	help
	  Say Y here if you have MediaTek touch panel.

	  If unsure, say N.

	  To compile this dirver as a module, choose M here: the
	  module will be called.

config TOUCHSCREEN_MTK_GT1151
	bool "GT1151 for Mediatek package"
	default n
	help
	  Say Y here if you have GT1151 touch panel.

	  If unsure, say N.

	  To compile this dirver as a module, choose M here: the
	  module will be called.

source "drivers/input/touchscreen/mediatek/GT1151/Kconfig"

config TOUCHSCREEN_HIMAX_HX852xES
	bool "Himax touchpanel HX852xES series"
	depends on I2C
	help
	  Say Y here if you have a Himax HX852xES touchscreen.
	  HX852xES controllers are multi touch controllers which can
	  report 10 touches at a time.

          If unsure, say N.

source "drivers/input/touchscreen/mediatek/hx852xes/Kconfig"

endif
```

## drivers/misc/mediatek/pmic/rt4813/Kconfig
```kconfig
config RT4813_BOOST
	bool "Support for RT5081 PMU part"
	depends on I2C
	help
	  Select Y
	  to enable
	  support
	  for RT4813 BOOST.
```
